## config/west.yml
```yaml
manifest:
  remotes:
    - name: zmkfirmware
      url-base: https://github.com/zmkfirmware
    - name: XinyiC222
      url-base: https://github.com/XinyiC222
  projects:
    - name: zmk
      remote: zmkfirmware
      revision: main
      import: app/west.yml
    - name: zmk-achroma-module
      remote: XinyiC222
      revision: main
  self:
    path: config
```
